## Kconfig
```kconfig
mainmenu "Anckor Kernel Configuration"

menu "build type"

config build_debug
	bool "debug build"
	default y
	help
	  	compile kernel with debug flags

endmenu

menu "kernel"

rsource "kernel/Kconfig"

endmenu

menu "platform"

rsource "platform/Kconfig"

endmenu

menu "arch"

rsource "arch/Kconfig"

endmenu

menu "drv"

rsource "drv/Kconfig"

endmenu

menu "lib"

rsource "lib/Kconfig"

endmenu

menu "tests"

rsource "tests/Kconfig"

endmenu
```

## arch/Kconfig
```kconfig
config module_arch
	bool "arch module"
	default y
	help
		architecture specific module
```

## drivers/timer/Kconfig
```kconfig
config module_drivers_timer
	bool "timer driver module"
	default y
	help
		timer driver module
```

## drivers/uart/Kconfig
```kconfig
config module_drivers_uart
	bool "uart driver module"
	default y
	help
		uart driver module
```

## drv/timer/Kconfig
```kconfig
config module_drv_timer
	bool "timer driver module"
	default y
	help
		timer driver module
```

## drv/uart/Kconfig
```kconfig
config module_drv_uart
	bool "uart driver module"
	default y
	help
		uart driver module
```

## examples/helloworld/Kconfig
```kconfig
config partition_examples_helloworld
	bool "helloworld app"
	depends on !module_tests
	default y
	help
		hello world application example
```

## kernel/Kconfig
```kconfig
config module_kernel
	bool "kernel module"
	default y
	help
	  	This module is core kernel one which contains base services 
	  	such as scheduling, threads creation, memory protection, etc...
```

## platform/Kconfig
```kconfig
config module_platform
	bool "platform module"
	default y
	help
	  	platform specific module
```

## tests/Kconfig
```kconfig
config module_tests
	bool "anckor test engine"
	default y
	help
		test engine

rsource "threads/Kconfig"
rsource "apps/Kconfig"
```

## tests/apps/Kconfig
```kconfig
config module_tests_apps
	bool "test apps app"
	depends on module_tests
	default n
	help
		test apps app
```

## tests/interrupt/Kconfig
```kconfig
config module_tests_interrupt
	bool "test interrupt app"
	depends on module_tests
	default y
	help
		test interrupt app
```

## tests/messages/Kconfig
```kconfig
config module_tests_messages
	bool "test message app"
	depends on module_tests
	default y
	help
		test messages api
```

## tests/threads/Kconfig
```kconfig
config module_tests_threads
	bool "test threads app"
	depends on module_tests
	default y
	help
		test threads app
```

## tools/defconfig/default_defconfig
```kconfig
#
# build type
#
# CONFIG_build_debug is not set
# end of build type

#
# kernel
#
CONFIG_module_kernel=y
# end of kernel

#
# platform
#
CONFIG_module_platform=y
# end of platform

#
# arch
#
CONFIG_module_arch=y
# end of arch

#
# drv
#
CONFIG_module_drv_uart=y
# CONFIG_module_drv_timer is not set
# end of drv

#
# lib
#
CONFIG_module_lib_libc=y
# end of lib

#
# tests
#
CONFIG_module_tests=y
CONFIG_module_tests_threads=y
CONFIG_module_tests_apps=y
CONFIG_module_tests_interrupt=y
# end of tests
```

## tools/defconfig/helloworld_defconfig
```kconfig
#
# build type
#
# CONFIG_build_debug is not set
# end of build type

#
# kernel
#
CONFIG_module_kernel=y
# end of kernel

#
# platform
#
CONFIG_module_platform=y
# end of platform

#
# arch
#
CONFIG_module_arch=y
# end of arch

#
# drv
#
CONFIG_module_drv_uart=y
# CONFIG_module_drv_timer is not set
# end of drv

#
# lib
#
CONFIG_module_lib_libc=y
# end of lib

#
# tests
#
# CONFIG_module_tests is not set
# end of tests

#
# examples
#
CONFIG_module_examples_helloworld=y
# end of examples
```
